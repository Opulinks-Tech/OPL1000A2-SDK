; *************************************************************
; *** Scatter-Loading Description File generated by uVision ***
; *************************************************************

LR_IROM1 0x00440000 0x0000F000  {    ; load region size_region
  RW_IRAM1 0x00440000 0x0000F000  {  ; RO + RW data
   .ANY (+RO)
   .ANY (+RW +ZI)
  }
}
